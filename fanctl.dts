/dts-v1/;
/plugin/;
 
/ {
    fragment@0 {
        target-path = "/";
        __overlay__ {
            fanctl {
                compatible = "fanctl";
                pwms = <&pwm 0 1000000>;
                status = "okay";
            };
        };
    };
};
